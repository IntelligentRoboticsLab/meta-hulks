## conf/distro/HULKs-DNT-OS.conf
```bitbake
require conf/distro/nao-core-minimal.conf

DISTRO = "HULKs-DNT-OS"
DISTRO_NAME = "HULKs-DNT-OS"
DISTRO_VERSION = "5.7.1"
```

## conf/distro/HULKs-OS.conf
```bitbake
require conf/distro/nao-core-minimal.conf

DISTRO = "HULKs-OS"
DISTRO_NAME = "HULKs-OS"
DISTRO_VERSION = "5.7.0"
```
